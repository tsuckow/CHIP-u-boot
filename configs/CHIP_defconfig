## configs/CHIP_defconfig
```kconfig
CONFIG_ARM=y
CONFIG_ARCH_SUNXI=y
CONFIG_MACH_SUN5I=y
CONFIG_DRAM_TIMINGS_DDR3_800E_1066G_1333J=y
# CONFIG_MMC is not set
CONFIG_USB0_VBUS_PIN="PB10"
CONFIG_AXP_GPIO=y
# CONFIG_VIDEO_HDMI is not set
CONFIG_VIDEO_COMPOSITE=y
CONFIG_VIDEO_LCD_MODE="x:480,y:272,depth:18,pclk_khz:9000,le:10,ri:5,up:3,lo:8,hs:30,vs:5,sync:3,vmode:0"
CONFIG_VIDEO_LCD_POWER="AXP0-1"
CONFIG_VIDEO_LCD_BL_EN="PB2"
CONFIG_DEFAULT_DEVICE_TREE="sun5i-r8-chip"
CONFIG_SPL=y
CONFIG_SYS_EXTRA_OPTIONS="CONS_INDEX=2,SPLASH_SCREEN_ALIGN,CMD_BMP,VIDEO_BMP_LOGO,ENV_IS_IN_NAND"
# CONFIG_CMD_IMLS is not set
CONFIG_CMD_GPIO=y
CONFIG_NAND_SUNXI=y
CONFIG_SYS_NAND_U_BOOT_OFFS=0x800000
CONFIG_AXP_ALDO3_VOLT=3300
CONFIG_AXP_ALDO4_VOLT=3300
CONFIG_USB_MUSB_GADGET=y
```

## drivers/eeprom/Kconfig
```kconfig
#
# EEPROM subsystem configuration
#

menu "EEPROM support"

config EEPROM
	bool "Enable EEPROM support"
	depends on DM
	help
	  Support for the EEPROMs

if EEPROM

config EEPROM_DS2431
	bool "Enable Maxim DS2431 EEPROM support"
	depends on W1
	help
	  Maxim DS2431 1-Wire EEPROM support

endif

endmenu
```

## drivers/w1/Kconfig
```kconfig
#
# W1 subsystem configuration
#

menu "1-Wire support"

config W1
	bool "Enable 1-Wire controllers support"
	depends on DM
	help
	  Support for the Dallas 1-Wire bus.

if W1

config W1_GPIO
	bool "Enable 1-Wire GPIO bitbanging"
	depends on DM_GPIO
	help
	  Emulate a 1-Wire bus using a GPIO.

endif

endmenu
```
